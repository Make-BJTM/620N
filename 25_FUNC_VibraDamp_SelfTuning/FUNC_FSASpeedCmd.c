/******************************************************************************
 深圳市汇川技术有限公司 版权所有（C）All rights reserved.
 文件名:    FUNC_FSASpeedCmd.c
 创建人：马世贤
 修订人：何云壮                 修订日期：2012.09.06
         姚虹                   2013.07.30
         伍庆                   2014.12.09
 描述：
     1.生成频谱分析速度指令

 修改记录：
     1.加入不同频率下频谱分析速度指令，修改了原有8K和16K数据
     2.增加了速度开环扫频
     3.重做了速度闭环扫频

******************************************************************************/

/* Includes ------------------------------------------------------------------*/
/* 引用头文件 */
#include "FUNC_GlobalVariable.h"
#include "FUNC_InterfaceProcess.h"
#include "FUNC_FunCode.h"
#include "FUNC_AuxFunCode.h"
#include "FUNC_ErrorCode.h"
#include "FUNC_COMMInterface.h"  // 频谱分析用
#include "FUNC_FSASpeedCmd.h"


//测定截止频率8KHZ（对应16KHZ采样频率）,chrip信号
static const int16 IqCmdBuff_Chirp[4096] = 
{
0,3,9,18,31,47,66,88,113,141,173,207,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-1327,
-1917,-2463,-2949,-3363,-3693,-3930,-4065,-4094,-4014,-3826,-3533,-3143,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-2299,
-3210,-3826,-4089,-3972,-3481,-2662,-1589,-362,902,2083,3065,3752,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3957,
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4094,-4090,4079,-4066,4048,-4028,4003,-3978,3948,-3917,3883,-3850,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-2952
};

//
static const int16 SpdCmdBuff_PRB[4096] = 
{
-1,1,1,1,1,1,1,1,1,1,1,1,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-1,
1,-1,1,1,1,1,1,-1,-1,-1,-1,-1,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-1,
1,-1,-1,1,1,1,-1,1,1,-1,1,-1,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-1,
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-1,-1,-1,1,-1,-1,-1,-1,-1,-1,1,-1,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-1
};
  
/* Private_TypesDefinitions --------------------------------------------------*/
/* 结构体变量定义 枚举变量定义 */

/* Private_Variables ---------------------------------------------------------*/
/* 文件内变量定义 */
static Uint16 SpdCmdCnt = 0;
static Uint16 PRBCmdCnt = 0;
static Uint16 SpdCmdDelayCnt = 0;
static Uint16 bit123 = 0;

static int32 FSAIqCmd = 0;
static int32 FSASpeedCmd = 0;

/* Exported_Functions --------------------------------------------------------*/
/* 可供其它文件调用的函数的声明 */
void GenerateFSASpdCmd(void);       // 生成频谱分析速度指令
void FSASendCtrl(void);             // 控制发送开环频率特性分析数据给上位机

/* Private_Functions ---------------------------------------------------------*/
/* 该文件内部调用的函数的声明 */


/*******************************************************************************
  函数名: int32 GenerateFSASpdCmd()
  输  入:
  输  出:
  子函数:
  描  述: 生成频谱分析指令
********************************************************************************/
void GenerateFSASpdCmd()
{
    int32 Ref = 0;

    // FS_AnalyzeStart表示启动频谱分析速度指令模式, 由上位机控制,
    // 启动频谱分析必须在伺服ON之后, 伺服运行状态由上位机检测
    if (AuxFunCodeUnion.code.FS_EnableSend == 0)
    {
        AuxFunCodeUnion.code.H2F_FSAState = 0;
    }
    if (1 == AuxFunCodeUnion.code.FS_AnalyzeStart)
    {     
        PRBCmdCnt = 0;
        if(AuxFunCodeUnion.code.FS_Mode == 1)
        {
            if(SpdCmdDelayCnt < (3 * STR_FUNC_Gvar.System.SpdFreq))
            {
                SpdCmdDelayCnt++;
                FSAIqCmd = 0;
                FSASpeedCmd = 0;
                Ref = 0;
                AuxFunCodeUnion.code.FS_TorqSat = 0;
                bit123 = 0x1;
            }
            else
            {
                if(SpdCmdCnt >= 4096)
                {
                    SpdCmdCnt = 4097;
                    Ref = 0;
                    // 此时允许发送数据
                    bit123 = 0x3;
                }
                else
                {
                    Ref = ((int32)IqCmdBuff_Chirp[SpdCmdCnt]* 8 * AuxFunCodeUnion.code.FS_SpdCmdAmpltd);
                    SpdCmdCnt++;
                    bit123 = 0x2;
                }
            }
        }
        else if (AuxFunCodeUnion.code.FS_Mode == 2)
        {
            if(SpdCmdDelayCnt < (3*STR_FUNC_Gvar.System.SpdFreq))
            {
                SpdCmdDelayCnt++;
                FSAIqCmd = 0;
                FSASpeedCmd = 0;
                Ref = 0;
                AuxFunCodeUnion.code.FS_TorqSat = 0;
                bit123 = 0x1;
            }
            else
            {
                if(SpdCmdCnt >= 4096)
                {
                    SpdCmdCnt = 4097;
                    Ref = 0;
                    FSAIqCmd = 0;
//                    FSASpeedCmd = 0;
                    // 此时允许发送数据
                    bit123 = 0x3;
                    AuxFunCodeUnion.code.H2F_FSAState = 1;
                }
                else
                {
                    FSAIqCmd = ((int32)IqCmdBuff_Chirp[SpdCmdCnt] * AuxFunCodeUnion.code.FS_IqTurbAmpltd / 100);
//                    FSASpeedCmd = ((int32)SpdCmdBuff_PRB[SpdCmdCnt] * AuxFunCodeUnion.code.FS_SpdRefAmpltd * 1000);
                    bit123 = 0x2;
                    SpdCmdCnt++;
                }
            }
        } 
    }
    else
    {
        Ref = 0;
        SpdCmdCnt = 0;
        SpdCmdDelayCnt = 0;
        FSAIqCmd = 0;
        if (AuxFunCodeUnion.code.H2F_FSAState == 2)
        {
            if(PRBCmdCnt >= 4096)
                {
                    PRBCmdCnt = 4097;
                    FSASpeedCmd = 0;
                }
            else
            {
                FSASpeedCmd = ((int32)SpdCmdBuff_PRB[PRBCmdCnt] * AuxFunCodeUnion.code.FS_SpdRefAmpltd * 1000);
                PRBCmdCnt++;
            }    
        }
        else
        {
            PRBCmdCnt = 0;
        }
    }

    //零速停机 急停转矩停机  抱闸处理
    if (AuxFunCodeUnion.code.H2F_FSAState == 2)
    {
        // 给出速度指令
        STR_FUNC_Gvar.SpdCtrl.SpdRef = 0;
        STR_FUNC_Gvar.FsaCmd.FSASpdCmd = FSASpeedCmd;
        STR_FUNC_Gvar.FsaCmd.FSAIqCmd = 0;
    }
    else if((STR_FUNC_Gvar.MonitorFlag.bit.ZeroSpdStop == 1)
       || (STR_FUNC_Gvar.MonitorFlag.bit.ToqStop == 1)
       || ((STR_FUNC_Gvar.MonitorFlag.bit.BrakeUnLock == 1)&&(STR_FUNC_Gvar.MonitorFlag.bit.RunMod == SPDMOD))
       || (STR_FUNC_Gvar.MonitorFlag.bit.PwmStatus == DISPWM))
    {
        STR_FUNC_Gvar.SpdCtrl.SpdRef = 0;
    }
    else if(STR_FUNC_Gvar.MonitorFlag.bit.OTClamp == 1) //超程处理
    {
        STR_FUNC_Gvar.SpdCtrl.SpdRef = STR_FUNC_Gvar.PosCtrl.PosReguOut;
    }
    else
    {
        // 给出速度指令
        STR_FUNC_Gvar.SpdCtrl.SpdRef = Ref;
        STR_FUNC_Gvar.FsaCmd.FSASpdCmd = FSASpeedCmd;
        STR_FUNC_Gvar.FsaCmd.FSAIqCmd = FSAIqCmd;
    }
}

void FSASendCtrl()
{    
    if (1 == AuxFunCodeUnion.code.FS_AnalyzeStart)
    {
        // 频谱分析采样正在进行时如果伺服不处于运行状态则告知数据无效
        if( (STR_FUNC_Gvar.MonitorFlag.bit.ServoRunStatus != 2))
        {
            // 将FS_EnableSend的第三位置1, 低两位保持不变;
            AuxFunCodeUnion.code.FS_EnableSend |= 0x4;
        }

        if ((SpdCmdCnt <= 4096) && (SpdCmdCnt > 0))
        {
            if (AuxFunCodeUnion.code.FS_Mode == 1)
            {
                UNI_OsciBuffer.all_16Bits[SpdCmdCnt-1] = UNI_FUNC_MTRToFUNC_FastList_16kHz.List.SpdFdb / 10000;
                UNI_OsciBuffer.all_16Bits[SpdCmdCnt+4095] = STR_FUNC_Gvar.SpdCtrl.SpdRef / 10000;
            }
            else
            {
                UNI_OsciBuffer.all_16Bits[SpdCmdCnt-1] = UNI_FUNC_MTRToFUNC_FSAFastList_16kHz.List.FSA_SpdReguOutPlusChirp;
                UNI_OsciBuffer.all_16Bits[SpdCmdCnt+4095] = UNI_FUNC_MTRToFUNC_FastList_16kHz.List.SpdFdb / 1000;
                UNI_OsciBuffer.all_16Bits[SpdCmdCnt+8191] = UNI_FUNC_MTRToFUNC_FastList_16kHz.List.SpdFdb / 1000;
//                UNI_OsciBuffer.all_16Bits[SpdCmdCnt+12287] = FSASpeedCmd / 1000;
//                UNI_OsciBuffer.all_16Bits[SpdCmdCnt+16383] = UNI_FUNC_MTRToFUNC_FSAFastList_16kHz.List.SpdReguOut;
            }

            if (UNI_FUNC_MTRToFUNC_FastList_16kHz.List.StatusFlag.bit.DOvarReg_Clt == 1)
            {
                AuxFunCodeUnion.code.FS_TorqSat |= 0x1;
            }
            if (UNI_FUNC_MTRToFUNC_FastList_16kHz.List.StatusFlag.bit.VoltVectorLmt == 1)
            {
                AuxFunCodeUnion.code.FS_TorqSat |= 0x2;
            }
            if (UNI_FUNC_MTRToFUNC_FastList_16kHz.List.StatusFlag.bit.CurSmpMode == 1)
            {
                AuxFunCodeUnion.code.FS_TorqSat |= 0x4;
            }
        }

                // 第三位保持不变, 更新低两位的最新值
        AuxFunCodeUnion.code.FS_EnableSend &= 0x4;
        AuxFunCodeUnion.code.FS_EnableSend |= (0x3 & bit123);
    }
    else
    {
        if ((PRBCmdCnt <= 4096) && (PRBCmdCnt > 0))
        {
            if (AuxFunCodeUnion.code.H2F_FSAState == 2)
            {
                UNI_OsciBuffer.all_16Bits[PRBCmdCnt-1] = FSASpeedCmd / 1000;
                UNI_OsciBuffer.all_16Bits[PRBCmdCnt+4095] = UNI_FUNC_MTRToFUNC_FSAFastList_16kHz.List.SpdReguOut;
            }
        }
    }

}

/********************************* END OF FILE *********************************/
